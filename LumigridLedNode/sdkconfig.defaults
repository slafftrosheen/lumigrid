## LumigridLedNode/sdkconfig.defaults
```kconfig
CONFIG_IDF_TARGET="esp32"
CONFIG_FREERTOS_HZ=1000
CONFIG_COMPILER_CXX_EXCEPTIONS=y
CONFIG_ESP_TASK_WDT_PANIC=y
CONFIG_HTTPD_WS_SUPPORT=y
CONFIG_ESPTOOLPY_FLASHSIZE_4MB=y
CONFIG_ESPTOOLPY_FLASHSIZE="4MB"
```

## lumigrid_led_node-main/firmware/components/led_effects/Kconfig
```kconfig
menu "LumiGrid LED Node"
config LUMIGRID_ALED_CH_MAX
    int "Max addressable LED channels (ESP32 classic: 4)"
    range 1 4
    default 4
endmenu
```

## lumigrid_led_node-main/firmware/main/Kconfig
```kconfig
menu "LumiGrid"
config LUMIGRID_TEST_MODE
  bool "Deterministic FX test mode"
  default n
endmenu
```
